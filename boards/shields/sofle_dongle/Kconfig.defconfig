## boards/shields/sofle_dongle/Kconfig.defconfig
```kconfig
# Copyright (c) 2024
# SPDX-License-Identifier: MIT

if SHIELD_SOFLE_DONGLE

config ZMK_KEYBOARD_NAME
    default "Sofle"

config ZMK_SPLIT_ROLE_CENTRAL
    default y

config ZMK_SPLIT
    default y

# Two peripherals: left + right half
config ZMK_SPLIT_BLE_CENTRAL_PERIPHERALS
    default 2

# Peripherals + BT profiles (2 + 5 = 7)
config BT_MAX_CONN
    default 7

config BT_MAX_PAIRED
    default 7

config ZMK_STUDIO
    default y

endif
```

## boards/shields/sofle_dongle/Kconfig.shield
```kconfig
# Copyright (c) 2024
# SPDX-License-Identifier: MIT

config SHIELD_SOFLE_DONGLE
    def_bool $(shields_list_contains,sofle_dongle)
```

## boards/shields/sofle_rgb/Kconfig.defconfig
```kconfig
# Copyright (c) 2024 TheMK Contributors
# SPDX-License-Identifier: MIT

if SHIELD_SOFLE_RGB_LEFT

config ZMK_KEYBOARD_NAME
	default "Sofle RGB"

config ZMK_SPLIT_ROLE_CENTRAL
	default y

endif # SHIELD_SOFLE_RGB_LEFT

if SHIELD_SOFLE_RGB_LEFT || SHIELD_SOFLE_RGB_RIGHT

config ZMK_SPLIT
	default y

endif # SHIELD_SOFLE_RGB_LEFT || SHIELD_SOFLE_RGB_RIGHT
```

## boards/shields/sofle_rgb/Kconfig.shield
```kconfig
# Copyright (c) 2024 TheMK Contributors
# SPDX-License-Identifier: MIT

config SHIELD_SOFLE_RGB_LEFT
	def_bool $(shields_list_contains,sofle_rgb_left)

config SHIELD_SOFLE_RGB_RIGHT
	def_bool $(shields_list_contains,sofle_rgb_right)
```

## config/west.yml
```yaml
manifest:
  remotes:
    - name: zmkfirmware
      url-base: https://github.com/zmkfirmware
    - name: mctechnology17
      url-base: https://github.com/mctechnology17
  projects:
    - name: zmk
      remote: zmkfirmware
      revision: v0.3
      import: app/west.yml
    - name: zmk-nice-oled
      remote: mctechnology17
      revision: v0.3/dev
      path: zmk-nice-oled
  self:
    path: config
```
